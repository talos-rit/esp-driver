## components/ads1015/Kconfig
```kconfig
menu "ADS1015 Configuration"

    config ADS1015_HIGH_THRESH
        int "ADS1015 HIGH THRESH"
        default 100
        help
          High threshhold for ADS1015 current sensing.

    config ADS1015_LOW_THRESH
        int "ADS1015 LOW THRESH"
        default -100
        help
          Low threshhold for ADS1015 current sensing.

endmenu
```

## components/ads1015/test/Kconfig
```kconfig
menu "ADS1015 Configuration"

    config ADS1015_TEST_SDA_PIN
        int "Test I2C SDA GPIO"
        default 18

    config ADS1015_TEST_SCL_PIN
        int "Test I2C SCL GPIO"
        default 19

    config ADS1015_TEST_I2C_BUS
        int "Test ADS1015 I2C Bus Number"
        default 1

    config ADS1015_TEST_ADDR
        hex "Test ADS1015 I2C Address"
        default 0x48

    config ADS1015_TEST_RDY_PIN
        int "ADS1015 RDY Pin"
        default 21
        help
            GPIO pin number for the ADS1015 RDY line.

    config ADS1015_TEST_DATA_RATE
        int "ADS1015 Data Rate"
        range 0 6
        default 6
        help
            Data rate of ADS1015 in samples per second.
            0=128SPS, 1=250SPS, 2=490SPS, 3=920SPS,
            4=1600SPS, 5=2400SPS, 6=3300SPS


endmenu
```

## components/driver_wifi/Kconfig
```kconfig
menu "Driver WiFi Configuration"

    choice DRIVER_WIFI_SAE_PWE_MODE
        prompt "WPA3 SAE PWE Mode"
        default DRIVER_WIFI_SAE_PWE_BOTH
        help
            Select SAE Password Element (PWE) derivation method:
            Hunt and Peck, Hash-to-Element (H2E), or both.

        config DRIVER_WIFI_SAE_PWE_HUNT_AND_PECK
            bool "Hunt and Peck"

        config DRIVER_WIFI_SAE_PWE_H2E
            bool "Hash-to-Element (H2E)"
            depends on DRIVER_WIFI_ENABLE_SAE_H2E

        config DRIVER_WIFI_SAE_PWE_BOTH
            bool "Both"
            depends on DRIVER_WIFI_ENABLE_SAE_H2E
    endchoice


    config DRIVER_WIFI_SAE_PASSWORD_IDENTIFIER
        string "SAE Password Identifier"
        depends on DRIVER_WIFI_SAE_PWE_H2E || DRIVER_WIFI_SAE_PWE_BOTH
        default ""
        help
            Optional password identifier used for SAE H2E mode.


    config DRIVER_WIFI_MAX_RETRY
        int "Maximum Retry Count"
        default 5
        help
            Maximum number of reconnection attempts before giving up.


    choice DRIVER_WIFI_SCAN_AUTH_MODE
        prompt "WiFi Scan Authentication Mode Threshold"
        default DRIVER_WIFI_AUTH_WPA2_PSK
        help
            The weakest authentication mode accepted when scanning.

        config DRIVER_WIFI_AUTH_OPEN
            bool "OPEN"

        config DRIVER_WIFI_AUTH_WEP
            bool "WEP"

        config DRIVER_WIFI_AUTH_WPA_PSK
            bool "WPA PSK"

        config DRIVER_WIFI_AUTH_WPA2_PSK
            bool "WPA2 PSK"

        config DRIVER_WIFI_AUTH_WPA_WPA2_PSK
            bool "WPA/WPA2 PSK"

        config DRIVER_WIFI_AUTH_WPA3_PSK
            bool "WPA3 PSK"

        config DRIVER_WIFI_AUTH_WPA2_WPA3_PSK
            bool "WPA2/WPA3 PSK"

        config DRIVER_WIFI_AUTH_WAPI_PSK
            bool "WAPI PSK"
    endchoice

endmenu
```

## components/encoder/Kconfig
```kconfig
menu "Encoder Configuration"

    config ENCODER_GLITCH_FILTER
        int "Encoder Glitch Filter"
        range 0 2147483647
        default 1000
        help 
            Pulses shorter than X nanoseconds are ignored.

    menu "Encoder 0"
        config ENCODER_0_P0_PIN
            int "Encoder P0 GPIO Pin"
            range 0 39
            default 12
        config ENCODER_0_P1_PIN
            int "Encoder P1 GPIO Pin"
            range 0 39
            default 13
        
        config ENCODER_0_RESOLUTION
            int "Encoder Resolution"
            default 20
            help 
                Number of slots in the encoder wheel. 
        
        config ENCODER_0_LIMB_GEAR_RATIO_X
            int "Encoder Gear Ratio Numerator(X)"
            range 1 2147483647
            default 20
            help 
                For every X rotations of the encoder wheel, the limb it controls rotates Y.

        config ENCODER_0_LIMB_GEAR_RATIO_Y
            int "Encoder Gear Ratio Denominator(Y)"
            range 1 2147483647
            default 1
            help 
                For every X rotations of the encoder wheel, the limb it controls rotates Y.

        config ENCODER_0_LIMB_REFERENCE
            int "Encoder Limb End Stop Angle"
            default 0
            help 
                The angle of the limb at which the end stop is triggered

        config ENCODER_0_ANGLE_INVERT
            int "Encoder Angle Invert"
            default 0
            range 0 1
            help 
                Flip sign of angles and counts used with this encoder

        config ENCODER_0_LIMIT_LOW
            int "Encoder Expected Lowest Count Value"
            default -32767
            help
                Used by the pulse counter to suspect if an encoder has drifted at the 
                limits of its motion. If the count of the encoder goes past this limit, 
                a warning is raised to the controller that something has gone wrong.
                If this limit is not set, it will default to being so small it should not 
                ever raise this warning. This value should be negative.
        config ENCODER_0_LIMIT_HIGH
            int "Encoder Expected Highest Count Value"
            default 32767
            help
                Used by the pulse counter to suspect if an encoder has drifted at the 
                limits of its motion. If the count of the encoder goes past this limit, 
                a warning is raised.
                If this limit is not set, it will default to being so large it should not 
                ever raise this warning. This value should be positive.

        
    endmenu

		
endmenu
```

## components/encoder/test/Kconfig
```kconfig
menu "Encoder Test Configuration"

    config ENCODER_P0_TEST_PIN
        int "Test Encoder P0 GPIO Pin"
        default 13

    config ENCODER_P1_TEST_PIN
        int "Test Encoder P1 GPIO Pin"
        default 12


endmenu
```

## components/i2c_bus/test/Kconfig
```kconfig
menu "I2CBUS Configuration"

    config I2CBUS_TEST_SDA_PIN
        int "Test I2C SDA GPIO"
        default 18

    config I2CBUS_TEST_SCL_PIN
        int "Test I2C SCL GPIO"
        default 19

endmenu
```
