## components/motorhat/test/Kconfig
```kconfig
menu "PCA9685 Configuration"

    config PCA9685_TEST_SDA_PIN
        int "Test I2C SDA GPIO"
        default 18

    config PCA9685_TEST_SCL_PIN
        int "Test I2C SCL GPIO"
        default 19

    config PCA9685_TEST_ADDR
        hex "Test I2C address"
        default 0x60

    config DRIVER_LIMIT_SWITCH_PIN
        int "Limit Switch Pin"
        default 23
        help
            GPIO pin for limit switch alerts.

endmenu
```
